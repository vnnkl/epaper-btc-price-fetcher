#include <WiFi.h>
#include <WiFiClientSecure.h>

#include <ArduinoJson.h>
#include <GxEPD2_BW.h>
#include <GxEPD2_3C.h>
#include <Fonts/FreeSansBold18pt7b.h>


char wifiSSID[] = "WiFi SSID";
char wifiPASS[] = "password";

GxEPD2_3C<GxEPD2_270c, GxEPD2_270c::HEIGHT> display(GxEPD2_270c(/*CS=5*/ SS, /*DC=*/ 22, /*RST=*/ 21, /*BUSY=*/ 4));

const char* host = "api.opennode.co";
const int httpsPort = 443;
String on_currency = "BTCUSD";
String on_currency2 = "BTCEUR";
String priceUSD;
String priceEUR;

const char* wl_status_to_string(wl_status_t status) {
  switch (status) {
    case WL_NO_SHIELD: return "WL_NO_SHIELD";
    case WL_IDLE_STATUS: return "WL_IDLE_STATUS";
    case WL_NO_SSID_AVAIL: return "WL_NO_SSID_AVAIL";
    case WL_SCAN_COMPLETED: return "WL_SCAN_COMPLETED";
    case WL_CONNECTED: return "WL_CONNECTED";
    case WL_CONNECT_FAILED: return "WL_CONNECT_FAILED";
    case WL_CONNECTION_LOST: return "WL_CONNECTION_LOST";
    case WL_DISCONNECTED: return "WL_DISCONNECTED";
  }
}

const unsigned char logo [] PROGMEM = {
  // 'BC_Logo_, 200x42px
  0xff, 0xff, 0xff, 0xff, 0xff, 0xff, 0xff, 0xff, 0xff, 0xff, 0xff, 0xff, 0xff, 0xff, 0xff, 0xff,
  0xff, 0xff, 0xff, 0xff, 0xff, 0xff, 0xff, 0xff, 0xff, 0xff, 0xff, 0xff, 0xff, 0xff, 0xff, 0xff,
  0xff, 0xff, 0xff, 0xff, 0xff, 0xff, 0xff, 0xff, 0xff, 0xff, 0xff, 0xff, 0xff, 0xff, 0xff, 0xff,
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  0xff, 0xff, 0xff, 0xff, 0xff, 0xff, 0xff, 0xff, 0xff, 0xff
};

const unsigned char logo_grey [] PROGMEM = {
// 'BC_Logotype_grey', 200x50px
0xff, 0xff, 0xff, 0xff, 0xff, 0xff, 0xff, 0xff, 0xff, 0xff, 0xff, 0xff, 0xff, 0xff, 0xff, 0xff,
0xff, 0xff, 0xff, 0xff, 0xff, 0xff, 0xff, 0xff, 0xff, 0xff, 0xff, 0xff, 0xff, 0xff, 0xff, 0xff,
0xff, 0xff, 0xff, 0xff, 0xff, 0xff, 0xff, 0xff, 0xff, 0xff, 0xff, 0xff, 0xff, 0xff, 0xff, 0xff,
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0xff, 0xff
};



void setup() {
  // put your setup code here, to run once:

  Serial.begin(115200);

  WiFi.begin(wifiSSID, wifiPASS);
  while (WiFi.status() != WL_CONNECTED) {
    Serial.println("connecting");
    Serial.println(wl_status_to_string(WiFi.status()));
    delay(500);
  }

  Serial.println("connected");

  display.init(115200);
  display.setRotation(3);
  display.setFont(&FreeSansBold18pt7b);
  display.setTextColor(GxEPD_RED);

  ONprice();

  display.firstPage();
  do
  {
    display.fillScreen(GxEPD_WHITE);
    display.drawInvertedBitmap(20, 20, logo_grey, 200, 50, GxEPD_BLACK);
    display.setCursor(0, 120);

    display.print("  "+priceUSD+" USD\n");
    display.print("  "+priceEUR+" EUR");
  }
  while (display.nextPage());
}

void ONprice() {
  WiFiClientSecure client;

  if (!client.connect(host, httpsPort)) {

    return;
  }

  String url = "/v1/rates";


  client.print(String("GET ") + url + " HTTP/1.1\r\n" +
               "Host: " + host + "\r\n" +
               "User-Agent: ESP32\r\n" +
               "Connection: close\r\n\r\n");

  while (client.connected()) {
    String line = client.readStringUntil('\n');
    if (line == "\r") {

      break;
    }
  }
  String line = client.readStringUntil('\n');

  const size_t capacity = 169 * JSON_OBJECT_SIZE(1) + JSON_OBJECT_SIZE(168) + 3800;

  DynamicJsonBuffer jsonBuffer(capacity);

  JsonObject& root = jsonBuffer.parseObject(line);

  JsonObject& data = root["data"];

  String temp = data[on_currency][on_currency.substring(3)];
  priceUSD = temp;
  String temp2 = data[on_currency2][on_currency2.substring(3)];
  priceEUR = temp2;
  Serial.println(priceUSD);
  Serial.println(priceEUR);
}

void loop() {
  // put your main code here, to run repeatedly:

}
